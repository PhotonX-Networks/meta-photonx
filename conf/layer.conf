## conf/layer.conf
```bitbake
# We have a conf and classes directory, add to BBPATH
BBPATH .= ":${LAYERDIR}"

# We have a recipes-* directories, add to BBFILES
BBFILES += "${LAYERDIR}/recipes-*/*/*.bb \
	${LAYERDIR}/recipes-*/*/*.bbappend"

BBFILE_COLLECTIONS += "photonx"
BBFILE_PATTERN_photonx = "^${LAYERDIR}/"
BBFILE_PRIORITY_photonx = "6"
```

## conf/machine/photonx.conf
```bitbake
#@TYPE: Machine
#@NAME: photonx

#@DESCRIPTION: Machine configuration for photonx systems


PREFERRED_PROVIDER_virtual/kernel ?= "linux-yocto"
PREFERRED_VERSION_linux-yocto ?= "3.14%"

DEFAULTTUNE ?= "corei7-64"
require conf/machine/include/tune-corei7.inc

require conf/machine/include/x86-base.inc

MACHINE_FEATURES += "efi pcbios"



MACHINE_EXTRA_RRECOMMENDS += "linux-firmware v86d"

EXTRA_OECONF_append_pn-matchbox-panel-2 = " --with-battery=acpi"
```
